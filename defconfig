## defconfig
```kconfig
# One Time Setup default configuration file


#############################  GLOBAL CONFIGURATION  ###########################

# Your name
USER_NAME=

# Your email
USER_EMAIL=

# Your machine type
# you have to choose between:
# * desktop
# * server (default)
MACHINE_TYPE=server

# Your access type on the machine
# you have to choose between:
# * admin
# * user (default)
MACHINE_ACCESS=user

# The theme used for your terminals, IDE...
# you have to choose between:
# * none (default)
# * solarized-dark (http://ethanschoonover.com/solarized)
# * solarized-light
CONFIG_THEME=none


####################################  SHELL  ###################################

# Configure the basic Shell
CONFIG_SHELL=y


####################################  BASH  ####################################

# Install and configure the Bourne Again SHell
# It can be used with solarized theme
CONFIG_BASH=y


#####################################  VIM  ####################################

# Install and configure Vim
# It can be used with solarized theme
CONFIG_VIM=y


#####################################  GIT  ####################################

# Install and configure Git
#CONFIG_GIT=y


####################################  REPO  ####################################

# Install Repo
#CONFIG_REPO=y


#####################################  SSH  ####################################

# Configure SSH
CONFIG_SSH=y


#################################  COMMON TOOLS  ###############################

# Install common tools
CONFIG_TOOLS=y


##############################  DEVELOPMENT TOOLS  #############################

# Install development tools
#CONFIG_DEVTOOLS=y


##############################  USER DIRECTORIES  ##############################

# Configure the user directories
# requires MACHINE_TYPE=desktop
#CONFIG_USER_DIRS=y


##################################  CHROMIUM  ##################################

# Install and configure the Chromium browser
# requires MACHINE_TYPE=desktop
CONFIG_CHROMIUM=y


##################################  GRAVATAR  ##################################

# Configure your Gravatar
# requires MACHINE_TYPE=desktop
CONFIG_GRAVATAR=y


###############################  GNOME TERMINAL  ###############################

# Install and configure GNOME Terminal
# requires MACHINE_TYPE=desktop
CONFIG_GNOME_TERMINAL=y


##################################  WALLPAPER  #################################

# Install and configure the wallpaper
# requires MACHINE_TYPE=desktop
# you have to choose between:
# * radiance-purple
# * simple-ubuntu-brown
# * ubuntu-brown-bubbles
# * ubuntu-brown
# * ubuntu-fizz
#CONFIG_WALLPAPER=


##################################  WIRESHARK  #################################

# Install and configure the Wireshark
# requires MACHINE_TYPE=desktop
#CONFIG_WIRESHARK=y
```
